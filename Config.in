## Config.in
```kconfig
# HALOS BSP buildroot main config

mainmenu "Halos BSP Buildroot $HALOS_VERSION Configuration"

config HAVE_DOT_CONFIG
	bool
	default y

config HALOS_VERSION
	string
	option env="HALOS_VERSION_FULL"

config HOSTARCH
	string
	option env="HOSTARCH"

config BUILD_DIR
	string
	option env="BUILD_DIR"

# Hidden config symbols for packages to check system gcc version
config HOST_GCC_VERSION
	string
	option env="HOST_GCC_VERSION"

config HOST_GCC_AT_LEAST_4_5
	bool
	default y if HOST_GCC_VERSION = "4 5"

config HOST_GCC_AT_LEAST_4_6
	bool
	default y if HOST_GCC_VERSION = "4 6"
	select HOST_GCC_AT_LEAST_4_5

config HOST_GCC_AT_LEAST_4_7
	bool
	default y if HOST_GCC_VERSION = "4 7"
	select HOST_GCC_AT_LEAST_4_6

config HOST_GCC_AT_LEAST_4_8
	bool
	default y if HOST_GCC_VERSION = "4 8"
	select HOST_GCC_AT_LEAST_4_7

config HOST_GCC_AT_LEAST_4_9
	bool
	default y if HOST_GCC_VERSION = "4 9"
	select HOST_GCC_AT_LEAST_4_8

config HOST_GCC_AT_LEAST_5
	bool
	default y if HOST_GCC_VERSION = "5"
	select HOST_GCC_AT_LEAST_4_9

config HOST_GCC_AT_LEAST_6
	bool
	default y if HOST_GCC_VERSION = "6"
	select HOST_GCC_AT_LEAST_5

config HOST_GCC_AT_LEAST_7
	bool
	default y if BR2_HOST_GCC_VERSION = "7"
	select HOST_GCC_AT_LEAST_6

config HOST_GCC_AT_LEAST_8
	bool
	default y if HOST_GCC_VERSION = "8"
	select HOST_GCC_AT_LEAST_7

# When adding new entries above, be sure to update
# the HOSTCC_MAX_VERSION variable in the Makefile.

# Hidden boolean selected by packages in need of Java in order to build
# (example: kodi)
config NEEDS_HOST_JAVA
	bool

# Hidden boolean selected by packages in need of javac in order to build
# (example: classpath)
config NEEDS_HOST_JAVAC
	bool

# Hidden boolean selected by packages in need of jar in order to build
# (example: classpath)
config NEEDS_HOST_JAR
	bool

# Hidden boolean selected by pre-built packages for x86, when they
# need to run on x86-64 machines (example: pre-built external
# toolchains, binary tools like SAM-BA, etc.).
config HOSTARCH_NEEDS_IA32_LIBS
	bool

# Hidden boolean selected by packages that need to build 32 bits
# binaries with the host compiler, even on 64 bits build machines (e.g
# bootloaders).
config HOSTARCH_NEEDS_IA32_COMPILER
	bool

# Hidden boolean selected by packages that need the host to have an
# UTF8 locale.
config NEEDS_HOST_UTF8_LOCALE
	bool

config DEFCONFIG_FROM_ENV
	string
	option env="HALOS_DEFCONFIG"

config HALOS_DEFCONFIG
	string "Location to save halosbuildroot config"
	default DEFCONFIG_FROM_ENV if DEFCONFIG_FROM_ENV != ""
	default "$(CONFIG_DIR)/defconfig"
	help
	  When running 'make savedefconfig', the defconfig file will be
	  saved in this location.

menu "Build options"

comment "Build config for commands toolchain option"
###########################commands ########################
menu "Commands"

config HALOS_SVN
	string "Subversion (svn) command"
	default "svn --non-interactive"

config HALOS_BZR
	string "Bazaar (bzr) command"
	default "bzr"

config HALOS_GIT
	string "Git command"
	default "git"

config HALOS_CVS
	string "CVS command"
	default "cvs"

config HALOS_CP
	string "copy files command"
	default "cp"

config HALOS_SCP
	string "Secure copy (scp) command"
	default "scp"

config HALOS_TAR_OPTIONS
	string "Tar options"
	default "tar"
	help
	  Options to pass to tar when extracting the sources.
	  E.g. " -v --exclude='*.svn*'" to exclude all .svn internal
	  files and to be verbose.

endmenu

menu "Board chip select"
comment "chose board chip option"

choice
	prompt "Linux OS Chip"
	default BOARDCHIP_HISI

config BOARDCHIP_HISI
	bool "hisi"
	help
	  hisi chip

config BOARDCHIP_NOVATEK
	bool "novatek"
	help
	  novatek chip

config BOARDCHIP_TI
	bool "ti"
	help
	  ti chip

config BOARDCHIP_ROCKCHIP
	bool "rockchip"
	help
	  rockchip chip
endchoice

if BOARDCHIP_HISI
source "config/vendor/hisi/Config.in"
endif

endmenu


endmenu

source "opensource/Config.in"
```

## config/vendor/hisi/Config.in
```kconfig
menu "Hisi chip select optin"

choice
	prompt "Hisi Chip ID"
	default BOARDCHIP_HISI_3519

config BOARDCHIP_HISI_3519
	bool "3519"
	help
	 3519

config BOARDCHIP_HISI_3559
	bool "3559"
	help
	 3559
endchoice


choice
	prompt "Hisi 3519 Product ID"
	default BOARDCHIP_HISI3519_A3
	depends on BOARDCHIP_HISI_3519

config BOARDCHIP_HISI3519_A3
	bool "A3"
	help
	 A3

config BOARDCHIP_HISI3519_RV
	bool "RV"
	help
	 RV

config BOARDCHIP_HISI3519_A4H
	bool "A4H"
	help
	 A4H

endchoice
endmenu
```

## opensource/Config.in
```kconfig
menu "open source(linux,uboot,busybox)"
comment "chose open source include linux uboot busybox"

source "opensource/uboot/Config.in"
source "opensource/kernel/Config.in"
source "opensource/busybox/Config.in"

endmenu
```

## opensource/uboot/Config.in
```kconfig
config TARGET_UBOOT
	bool "U-Boot"
	default y
	help
	  Build "Das U-Boot" Boot

if TARGET_UBOOT

if BOARDCHIP_HISI_3519
source "opensource/uboot/hisi_3519/Config.in"
endif

endif
```
